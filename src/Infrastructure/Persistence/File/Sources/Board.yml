## src/Infrastructure/Persistence/File/Sources/Board.yml
```yaml
board:
    prefixHuman: H
    prefixRobot: R
    gameIsActive: true
    rows: 3
    columns: 3
    cells: [[{ content: H, rating: 108 }, { content: H, rating: 107 }, { content: 0, rating: 112 }, { content: H, rating: 108 }], [{ content: H, rating: 7 }, { content: R, rating: 8 }, { content: H, rating: 3 }, { content: 0, rating: 7 }], [{ content: R, rating: 1007 }, { content: R, rating: 1008 }, { content: R, rating: 1013 }, { content: R, rating: 1007 }], [{ content: H, rating: 3 }, { content: H, rating: 2 }, { content: R, rating: 7 }, { content: R, rating: 3 }]]
    turn: Robot
```

## src/Infrastructure/Persistence/Memory/Sources/Board.yml
```yaml
board:
    gameIsActive: true
    rows: 3
    columns: 3
    cells: [[{ content: R, rating: 3 }, { content: H, rating: 2 }, { content: R, rating: 7 }, { content: H, rating: 3 }], [{ content: R, rating: 7 }, { content: H, rating: 8 }, { content: H, rating: 3 }, { content: R, rating: 7 }], [{ content: H, rating: 7 }, { content: R, rating: 3 }, { content: R, rating: 8 }, { content: H, rating: 2 }], [{ content: 0, rating: 3 }, { content: 0, rating: 7 }, { content: 0, rating: 7 }, { content: 0, rating: 3 }]]
    turn: Robot
```

## tests/Double/Persistence/Memory/Sources/Board.yml
```yaml
board:
    gameIsActive: true
    rows: 6
    columns: 6
    cells: [[{ content: 0, rating: 3 }, { content: 0, rating: 2 }, { content: 0, rating: 2 }, { content: 0, rating: 2 }, { content: 0, rating: 2 }, { content: 0, rating: 2 }, { content: 0, rating: 3 }], [{ content: 0, rating: 2 }, { content: 0, rating: 3 }, { content: 0, rating: 2 }, { content: 0, rating: 2 }, { content: 0, rating: 2 }, { content: 0, rating: 3 }, { content: 0, rating: 2 }], [{ content: 0, rating: 2 }, { content: 0, rating: 2 }, { content: 0, rating: 3 }, { content: 0, rating: 2 }, { content: 0, rating: 3 }, { content: 0, rating: 2 }, { content: 0, rating: 2 }], [{ content: 0, rating: 2 }, { content: 0, rating: 2 }, { content: 0, rating: 2 }, { content: 0, rating: 3 }, { content: 0, rating: 2 }, { content: 0, rating: 2 }, { content: 0, rating: 2 }], [{ content: 0, rating: 2 }, { content: 0, rating: 2 }, { content: 0, rating: 3 }, { content: 0, rating: 2 }, { content: 0, rating: 3 }, { content: 0, rating: 2 }, { content: 0, rating: 2 }], [{ content: 0, rating: 2 }, { content: 0, rating: 3 }, { content: 0, rating: 2 }, { content: 0, rating: 2 }, { content: 0, rating: 2 }, { content: 0, rating: 3 }, { content: 0, rating: 2 }], [{ content: 0, rating: 3 }, { content: 0, rating: 2 }, { content: 0, rating: 2 }, { content: 0, rating: 2 }, { content: 0, rating: 2 }, { content: 0, rating: 2 }, { content: 0, rating: 3 }]]
    turn: Human
```
